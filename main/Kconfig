## main/Kconfig
```kconfig
menu "Elboni Configuration"

	orsource "$IDF_PATH/examples/common_components/env_caps/$IDF_TARGET/Kconfig.env_caps"

    config RS485_PORT_NUM
        int "RS485 port number"
        range 0 2 if IDF_TARGET_ESP32 || IDF_TARGET_ESP32S3
        default 2 if IDF_TARGET_ESP32 || IDF_TARGET_ESP32S3
        range 0 1
        default 1
        help
            RS485 communication port number for the example.
            See RS485 documentation for available port numbers.

    config RS485_BAUD_RATE
        int "RS485 communication speed"
        range 1200 115200
        default 115200
        help
            RS485 communication speed for Modbus example.

    config RS485_RXD
        int "RS485 RXD pin number"
        range ENV_GPIO_RANGE_MIN ENV_GPIO_IN_RANGE_MAX
        default 43
        help
            GPIO number for RS485 RX pin. See RS485 documentation for more information
            about available pin numbers for RS485.

    config RS485_TXD
        int "RS485 TXD pin number"
        range ENV_GPIO_RANGE_MIN ENV_GPIO_OUT_RANGE_MAX
        default 44
        help
            GPIO number for RS485 TX pin. See RS485 documentation for more information
            about available pin numbers for RS485RS485.

    config RS485_STACK_SIZE
        int "RS485 echo example task stack size"
        range 1024 16384
        default 2048
        help
            Defines stack size for RS485 echo example. Insufficient stack size can cause crash.

    config CAN_TX
        int "CAN TX GPIO number"
        default 21 if IDF_TARGET_ESP32
        default 6
        help
            This option selects the GPIO pin used for the TX signal. Connect the
            TX signal to your transceiver.

    config CAN_RX
        int "CAN RX GPIO number"
        default 22 if IDF_TARGET_ESP32
        default 0
        help
            This option selects the GPIO pin used for the RX signal. Connect the
            RX signal to your transceiver.
			
	config CAN_STACK_SIZE
        int "RS485 echo example task stack size"
        range 1024 16384
        default 4096
        help
            Defines stack size for RS485 echo example. Insufficient stack size can cause crash.
			
	config SD_FORMAT_IF_MOUNT_FAILED
        bool "Format the card if mount failed"
        default n
        help
            If this config item is set, format_if_mount_failed will be set to true and the card will be formatted if
            the mount has failed.

    config SDMMC_PIN_CMD
        int "SDMMC CMD GPIO number"
        default 15 if IDF_TARGET_ESP32
        default 35 if IDF_TARGET_ESP32S2
        default 1 if IDF_TARGET_ESP32S3
        default 5  if IDF_TARGET_ESP32H2
        default 4  # C3 and others

    config SDMMC_PIN_DO
        int "SDMMC D0 GPIO number"
        default 2 if IDF_TARGET_ESP32
        default 37 if IDF_TARGET_ESP32S2
        default 4 if IDF_TARGET_ESP32S3
        default 0  if IDF_TARGET_ESP32H2
        default 6  # C3 and others

    config SDMMC_PIN_CLK
        int "SDMMC CLK GPIO number"
        default 14 if IDF_TARGET_ESP32
        default 36 if IDF_TARGET_ESP32S2
        default 2 if IDF_TARGET_ESP32S3
        default 4  if IDF_TARGET_ESP32H2
        default 5  # C3 and others

    config SDMMC_EXTERN_POWER_PIN
        int "tca9554 output pin that is by use for SDCARD"
        default 7

    choice SDMMC_BUS_WIDTH
        prompt "SD/MMC bus width"
        default SDMMC_BUS_WIDTH_1
        help
            Select the bus width of SD or MMC interface.
            Note that even if 1 line mode is used, D3 pin of the SD card must have a pull-up resistor connected.
            Otherwise the card may enter SPI mode, the only way to recover from which is to cycle power to the card.

        config SDMMC_BUS_WIDTH_4
            bool "4 lines (D0 - D3)"

        config SDMMC_BUS_WIDTH_1
            bool "1 line (D0)"
    endchoice

    choice SDMMC_SPEED_MODE
        prompt "SD/MMC speed mode"
        default SDMMC_SPEED_DS

        config SDMMC_SPEED_HS
            bool "High Speed"
        config SDMMC_SPEED_UHS_I_SDR50
            bool "UHS-I SDR50 (100 MHz, 50 MB/s)"
            depends on SOC_SDMMC_UHS_I_SUPPORTED
        config SDMMC_SPEED_UHS_I_DDR50
            bool "UHS-I DDR50 (50 MHz, 50 MB/s)"
            depends on SOC_SDMMC_UHS_I_SUPPORTED
    endchoice

    if SDMMC_BUS_WIDTH_4

        config SDMMC_PIN_D1
            int "D1 GPIO number"
            default 38 if IDF_TARGET_ESP32S3
            default 40 if IDF_TARGET_ESP32P4

        config SDMMC_PIN_D2
            int "D2 GPIO number"
            default 33 if IDF_TARGET_ESP32S3
            default 41 if IDF_TARGET_ESP32P4

        config SDMMC_PIN_D3
            int "D3 GPIO number"
            default 34 if IDF_TARGET_ESP32S3
            default 42 if IDF_TARGET_ESP32P4

    endif  # EXAMPLE_SDMMC_BUS_WIDTH_4

    config I2C_1_SCL
        int "SCL GPIO Num"
        range ENV_GPIO_RANGE_MIN ENV_GPIO_OUT_RANGE_MAX
        default 9 if IDF_TARGET_ESP32 || IDF_TARGET_ESP32S2 || IDF_TARGET_ESP32S3
        default 2
        help
            GPIO number for I2C Master clock line.

    config I2C_1_SDA
        int "SDA GPIO Num"
        range ENV_GPIO_RANGE_MIN ENV_GPIO_OUT_RANGE_MAX
        default 8 if IDF_TARGET_ESP32 || IDF_TARGET_ESP32S2 || IDF_TARGET_ESP32S3
        default 1
        help
            GPIO number for I2C Master data line.
			
	config I2C_0_SCL
        int "RTC SCL GPIO Num"
        range ENV_GPIO_RANGE_MIN ENV_GPIO_OUT_RANGE_MAX
        default 7 if IDF_TARGET_ESP32 || IDF_TARGET_ESP32S2 || IDF_TARGET_ESP32S3
        default 2
        help
            GPIO number for I2C RTC clock line.

    config I2C_0_SDA
        int "RTC SDA GPIO Num"
        range ENV_GPIO_RANGE_MIN ENV_GPIO_OUT_RANGE_MAX
        default 15 if IDF_TARGET_ESP32 || IDF_TARGET_ESP32S2 || IDF_TARGET_ESP32S3
        default 1
        help
            GPIO number for I2C RTC data line.
			
	config RTC_ALARM_PIN
        int "RTC ISR GPIO Num"
        default -1 if IDF_TARGET_ESP32 || IDF_TARGET_ESP32S2 || IDF_TARGET_ESP32S3
        default 1
        help
            GPIO number for I2C RTC data line.
endmenu
```
